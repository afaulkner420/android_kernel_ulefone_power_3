&i2c1 {
	rt9465@4b {
		compatible = "richtek,rt9465";
		reg = <0x4b>;
		status = "okay";
		rt,en_gpio_num = <0>;
		rt,en_gpio = <&pio 0 0x0>;
		mt6306_en_pin = <1>;
		rt,intr_gpio_num = <9>; /* direct defined GPIO num */
		rt,intr_gpio = <&pio 9 0x0>;
		interrupt-names = "wdtmri";
		charger_name = "secondary_chg";
		ichg = <1500000>; /* uA */
		mivr = <4500000>; /* uV */
		cv = <4550000>; /* uV */
		ieoc = <700000>; /* uA */
		safety_timer = <12>; /* hour */
		en_st; /* safety timer */
		/* en_te; */
		en_wdt;
	};
};
