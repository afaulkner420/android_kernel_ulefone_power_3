## Kconfig
```kconfig
#
# For a description of the syntax of this configuration file,
# see Documentation/kbuild/kconfig-language.txt.
#
mainmenu "Linux/$ARCH $KERNELVERSION Kernel Configuration"

config SRCARCH
	string
	option env="SRCARCH"

# Add project macro resolution by guangxu.wang 20171121 start
config CUSTOM_TRAN_PROJECT
	string "CUSTOM_TRAN_PROJECT"

config CUSTOM_TRAN_BOM
	string "CUSTOM_TRAN_BOM"
# Add project macro resolution by guangxu.wang 20171121 end

source "arch/$SRCARCH/Kconfig"
```

## drivers/input/fingerprint/Kconfig
```kconfig
#
#Fingerprint
#
menu "Fingerprint support"
	depends on INPUT

config MTK_FINGERPRINT_SUPPORT
	bool "Mediatek Fingerprint"
	default n
	---help---
	Fingerprint mtk driver enable/disable in the kernel.
	Say Y here if you want to use mediatek fingerprint driver,
	fingerprint driver will support fingerprint function

if MTK_FINGERPRINT_SUPPORT
config MTK_FINGERPRINT_SELECT
	string "sensor type"
	default "GF318M"


if MTK_FINGERPRINT_SELECT = "FPC1145"
config FPC_FINGERPRINT
	bool "FPC Fingerprint"
	default y
	---help---
	FPC fingerprint FPC's 102x/104x device.
endif

if MTK_FINGERPRINT_SELECT = "GF318M" ||  MTK_FINGERPRINT_SELECT = "GF5216"
config GOODIX_FINGERPRINT
	bool "Goodix Fingerprint"
	default y
	---help---
	Goodix Fingerprint chip GF316M/GF318M/GF3118M/GF518M/GF5118M/GF516M/GF816M/GF3208/GF3206/GF3266/GF3288/GF5206/GF5216/GF5208 TEE driver

config GOODIX_SENSOR_TYPE
	string "SENSOR_TYPE"
	default "GF5216"
	---help---
	Must input sensor type, or default is GF316M GF318M GF3118M GF518M GF5118M GF516M GF816M GF3208 GF3206 GF3266 GF3288 GF5206 GF5216 GF5208
endif
if MTK_FINGERPRINT_SELECT = "BLESTECH"
config BLESTECH_FINGERPRINT
    bool "blestech Fingerprint"
    default y
    ---help---
    blestech fingerprint.
endif
if MTK_FINGERPRINT_SELECT = "BLESTECH_TEE"
config BLESTECH_TEE_FINGERPRINT
    bool "blestech tee Fingerprint"
    default y
    ---help---
    blestech tee fingerprint.
endif
if MTK_FINGERPRINT_SELECT = "MICROARRAY"
config MICROARRAY_FINGERPRINT
    bool "microarray Fingerprint"
    default y
    ---help---
    microarray fingerprint.
endif
if MTK_FINGERPRINT_SELECT = "SUNWAVECORP"
config SUNWAVECORP_FINGERPRINT
    bool "sunwavecorp Fingerprint"
    default y
    ---help---
    sunwavecorp fingerprint.
endif
endif
endmenu
```

## drivers/input/touchscreen/mediatek/Kconfig
```kconfig
#
# Touchscreen driver configuration
#
menuconfig INPUT_TOUCHSCREEN
	bool "Touchscreens"
	help
	  Say Y here, and a list of supported touchscreens will be displayed.
	  This option doesn't affect the kernel.

	  If unsure, say Y.

if INPUT_TOUCHSCREEN

config TOUCHSCREEN_MTK
	bool "MediaTek Touch Panel Driver"
	help
	  Say Y here if you have MediaTek touch panel.

	  If unsure, say N.

	  To compile this dirver as a module, choose M here: the
	  module will be called.

config TOUCHSCREEN_PHYSICAL_ROTATION_WITH_LCM
	bool "MediaTek Touch Panel Rotation With LCM"
	default y
	help
	  Say N here if touch panel is not physical rotated as LCM does.
	  Physically rotated means that this driver will map
	  the reported coordination to diagonal position.

	  If unsure, say Y.

config TOUCHSCREEN_MTK_GT1151
	bool "GT1151 for Mediatek package"
	default n
	help
	  Say Y here if you have GT1151 touch panel.

	  If unsure, say N.

	  To compile this dirver as a module, choose M here: the
	  module will be called.

source "drivers/input/touchscreen/mediatek/GT1151/Kconfig"

config TOUCHSCREEN_MTK_NT36672_X604
        bool "FT8006U for Mediatek package"
        default n
        help
          Say Y here if you have NT36672 touch panel.

          If unsure, say N.

          To compile this dirver as a module, choose M here: the
          module will be called.

source "drivers/input/touchscreen/mediatek/nt36672_x604/Kconfig"


config TOUCHSCREEN_MTK_EKTH3676C_X605
        bool "EKTH3676C_X605 for Mediatek package"
        default n
        help
          Say Y here if you have EKTH3676C_605 touch panel.

          If unsure, say N.

          To compile this dirver as a module, choose M here: the
          module will be called.


# add XLLSHLSS-4 by qiang.xue 20171205 start
config CTP_SUSPEND_RESUME_CUSTOM
        bool "Transsion Custom TP resume and suspend"
        default n
        help
        Say Y here to enable custom CTP_suspend_resume.

        If unsure, say N.

        To compile this dirver as a module, choose M here: the
        module will be called
# add XLLSHLSS-4 by qiang.xue 20171205 end

config CTP_SUSPEND_BEFORE_LCM_CUSTOM_X604
	bool "Transsion Custom TP suspend"
	default n
        help
          Say Y here to enable custom ctp_suspend_before_lcm.

          If unsure, say N.

          To compile this dirver as a module, choose M here: the
          module will be called.

config TOUCHSCREEN_MTK_GT5688
	bool "GT1151 for Mediatek package"
	default n
	help
	  Say Y here if you have GT5688 touch panel.

	  If unsure, say N.

	  To compile this dirver as a module, choose M here: the
	  module will be called.

source "drivers/input/touchscreen/mediatek/GT5688/Kconfig"

config TOUCHSCREEN_MTK_GT911
	bool "GT911 for Mediatek package"
	help
	  Say Y here if you have GT911 touch panel.

	  If unsure, say N.

source "drivers/input/touchscreen/mediatek/GT911/Kconfig"

config TOUCHSCREEN_FT5X26
	bool "FT5X26 for Mediatek package"
	default n
	help
	  Say Y here if you have FT5X26 touch panel.

	  If unsure, say N.

	  To compile this dirver as a module, choose M here: the
	  module will be called.

source "drivers/input/touchscreen/mediatek/FT5X26/Kconfig"

config TOUCHSCREEN_MTK_GSLX680
	bool "gslX680 for Mediatek package"
	help
	  Say Y here if you have gslX680 touch panel.

	  If unsure, say N.

config TOUCHSCREEN_MTK_NT36xxx
	bool "NT36xxx for Mediatek package"
	default n
	help
	  Say Y here if you have NT36xxx touch panel.

	  If unsure, say N.

	  To compile this dirver as a module, choose M here: the
	  module will be called.

source "drivers/input/touchscreen/mediatek/NT36xxx/Kconfig"

endif
```

## drivers/input/touchscreen/mediatek/gn_nt36xxx/Kconfig
```kconfig
#
# Touchscreen driver configuration
#
if TOUCHSCREEN_MTK_NT36xxx

choice
	default TOUCHSCREEN_NT36xxx_1080_1920
		prompt "Novatek NT36xxx Panels"

config TOUCHSCREEN_NT36xxx_1080_1920
		bool "NT36xxx_1080_1920"
		depends on I2C
		help
			Say Y here if you have a Novatek NT36xxx Panel
			to the host processor over I2C

			If unsure, say N.
endchoice

endif
```

## drivers/input/touchscreen/mediatek/novatek/Kconfig
```kconfig
#
# Touchscreen driver configuration
#
if TOUCHSCREEN_MTK_NT36XXX                    

config NT36XXX_FIRMWARE                       
string "NT36XXX for Mediatek firmware"    

config NT36XXX_PROC                         
string "NT36XXX for Mediatek proc"      

config NT36XXX_MP                 
bool "NT36XXX for Mediatek mp"

config NT36XXX
string "NT36XXX FOR Mediatek"
default n                               
help                                    
Say Y here if you have GT1XX touch panel
```

## drivers/misc/mediatek/cam_cal/Kconfig
```kconfig
config MTK_CAM_CAL
	bool "MTK camera cal driver"
	default n
	help
	  CONFIG_MTK_CAM_CAL define if the camera cal driver should be built in or not.
	  If you want to use EEPROM for sensor. You have enable CONFIG_MTK_CAM_CAL on ProjectConfig.
	  The kernel space for EEPROM will be build. It may be like as "/dev/CAM_CAL_DRV".
	  Use space code will control the driver by open and ioctrl this one.

#add otp by ming.liao 20171129 start
config MTK_CAM_CAL_S5K3P9_EEPROM_SUPPORT
  bool CONFIG_MTK_CAM_CAL_S5K3P9_EEPROM_SUPPORT
  default n
  help
    CONFIG_MTK_CAM_CAL define if the camera cal driver should be built in or not
#add otp by ming.liao 20171129 start
```

## drivers/misc/mediatek/hall_rlk/Kconfig
```kconfig
config SENSORS_HALL
        bool "hall for transsion solution"
        default n
```

## drivers/misc/mediatek/lcm/Kconfig
```kconfig
config MTK_LCM
	bool "Enble LCM driver"
	default n
	help
	  define LCM driver config to enable LCM driver.
	  To set LCM driver which you choose avoid cannot driver LCM.
	  Please make sure CONFIG_MTK_LCM in xxxxxx_defconfig.mk.
	  And also make sure true on in ProjectConfig.mk

config CUSTOM_KERNEL_LCM
	string "define mediatek kernel LCM driver"
	help
	  To choose kernel LCM driver name.
	  This config is to select which LCM driver you want to use.
	  Please make sure CUSTOME_KERNEL_LCM in xxxxx_defconfig.mk.
	  And also make sure turn on in ProjectConfig.mk

config MTK_LCM_DEVICE_TREE_SUPPORT
	bool "support LCM device tree connect with display drivers"
	help
	  Decide whether to support LCM device tree based configuration.
	  This feature requires the connection between display driver and LCM devices.
	  Please also turn on MTK_LCM_DEVICE_TREE_SUPPORT in ProjectConfig.mk.
	  If not define MTK_LCM_DEVICE_TREE_SUPPORT
	  there will not connect between display driver and LCM devices.

#add by zhangkun for set avdd && avee voltage value --begin--
config TRAN_LCM_SET_VOLTAGE
	bool "Enble LCM set voltage"
	default n
	help
	  define LCM driver config to enable LCM auto set voltage.
	  To set LCM voltage  which you can set different value.
	  Please make sure CONFIG_TRAN_LCM_SET_VOLTAGE in
	  xxxxxx_defconfig.mk for transsion.
#add by zhangkun for set avdd && avee voltage value --end--
#add by tao.wang for x604 project time optimization mechanism start
config TRAN_LCM_TIME_OPT_ENABLE
	bool "Enble LCM TIME OPTIMIZE MACHANISM"
	default n
	help
	  define LCM driver config to enable LCM TIME OPTIMIZE function.
	  Enable this function can take advantage of the time that display driver
	  executes as the time of LCM 0x11 delay time.The purpose of this function
	  is to accelerate wake-up time.
#add by tao.wang for x604 project time optimization mechanism end
```

## drivers/misc/mediatek/pmic/mt6370/Kconfig
```kconfig
config MFD_MT6370_PMU
	bool "Support for MT6370 PMU part"
	depends on I2C
	select MFD_CORE
	select RT_REGMAP
	help
	  Select Y
	  to enable
	  support
	  for MT6370 PMU.

config MT6370_PMU_CHARGER
	bool "MT6370 PMU Charger Part"
	depends on MFD_MT6370_PMU
	help
	  Say Y here
	  to enable
	  supprot for MT6370
	  charger device.

config MT6370_PMU_CHARGER_TYPE_DETECT
	bool "MT6370 PMU Charger Type Detect"
	depends on MT6370_PMU_CHARGER
	depends on MTK_EXTERNAL_CHARGER_TYPE_DETECT
	help
	  Say Y here
	  to enable
	  supprot for MT6370
	  charger type detect.

config MT6370_PMU_FLED
	bool "MT6370 PMU FLED Part"
	depends on LEDS_CLASS && MFD_MT6370_PMU
	select FLASHLIGHT
	select RT_FLASH_LED
	help
	  Say Y here
	  to enable
	  supprot for
	  MT6370 fled device.

config MT6370_PMU_BLED
	bool "MT6370 PMU BLED Part"
	depends on LEDS_CLASS && MFD_MT6370_PMU
	help
	  Say Y here
	  to enable supprot
	  for
	  MT6370 bled device.

config MT6370_PMU_RGBLED
	bool "MT6370 PMU RGBLED Part"
	depends on LEDS_CLASS && MFD_MT6370_PMU
	help
	  Say Y here
	  to enable supprot
	  for
	  MT6370 rgbled device.

config MT6370_PMU_LDO
	bool "MT6370 PMU LDO Part"
	depends on REGULATOR && REGULATOR_MTK && MFD_MT6370_PMU
	help
	  Say Y here
	  to enable
	  support for
	  MT6370 ldo device.

config MT6370_PMU_DSV
	bool "MT6370 PMU DSV Part"
	depends on REGULATOR && REGULATOR_MTK && MFD_MT6370_PMU
	help
	  Say Y here to
	  enable support
	  for
	  MT6370 dsv device.
```

## drivers/misc/mediatek/sensors-1.0/magnetometer/akm09918/Kconfig
```kconfig
config MTK_AKM09918
	bool "AKM09918 for MediaTek package"
	default n
	help
	  It support different magnetometer sensor.
	  If this option is set,
	  it will support
	  AKMD09918 magnetometer.

#add CAQGHLSS-1 by jixiaopan 20171124 start
if MTK_AKM09918
config AKM_DEVICE_SELECT
        string "akm device type"
        default "NO"

if AKM_DEVICE_SELECT = "akm09916"
config AKM_DEVICE_AKM09916
        bool "AKM_Device_AK09916"
        default y
        ---help---
         AKM_Device_AK09916 FACTORY CIT
endif
endif
#add CAQGHLSS-1 by jixiaopan 20171124 end
```

## drivers/misc/mediatek/tfa98xx/Kconfig
```kconfig
config SMARTPA_TFA98XX
	bool "SMARTPA TFA98XX I2C DRIVER"
	default n
	help
	  It support NXP smartpa tfa98xx i2c driver.
```

## drivers/misc/mediatek/tkcore/Kconfig
```kconfig
# Trusted Execution Environment Configuration
config TRUSTKERNEL_TEE_SUPPORT
	bool "TrustKernel Trusted Execution Environment Support"
	default n
	---help---
	  This implements TrustKernel TKcore Linux Driver.

config TRUSTKERNEL_TEE_RPMB_SUPPORT
	bool "TrustKernel Trusted Execution Environment RPMB Support"
	default n
	---help---
	  This implements TrustKernel TKcore Linux Driver Replay Protected
	  Memory Block function.

config TRUSTKERNEL_TEE_FP_SUPPORT
	bool "TrustKernel Trusted Execution Environment Fingerprint Support"
	default n
	---help---
	  This implements TrustKernel TKcore Linux Driver SPI function.
```

## drivers/misc/mediatek/transsion_pen/Kconfig
```kconfig
config  TRANSSION_PEN
        bool "hall for transsion solution"
        default n
```
